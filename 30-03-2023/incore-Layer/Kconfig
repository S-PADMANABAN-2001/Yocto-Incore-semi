## 30-03-2023/incore-Layer/Kconfig
```kconfig
config INCORE_ETH
tristate "IncoreEthernet"
default m
help
Incore Ethernet Module
```

## 30-03-2023/incore-Layer/conf/layer.conf
```bitbake
BBPATH .= ":${LAYERDIR}"

BBFILES += "${LAYERDIR}/recipes-*/*.bb \
            ${LAYERDIR}/recipes-*/*/*.bbappend"

BBFILE_COLLECTIONS += "incore"
BBFILE_PATTERN_incore = "^${LAYERDIR}/"

LAYERSERIES_COMPAT_incore = "langdale"
```
